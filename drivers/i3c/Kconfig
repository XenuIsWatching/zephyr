## tests/drivers/counter/counter_capture/Kconfig
```kconfig
# Copyright (c) 2026 Meta Platforms
# SPDX-License-Identifier: Apache-2.0

mainmenu "Counter capture test configuration"

source "Kconfig.zephyr"

config NUM_OF_CONTINOUS_CAPTURES
	int "Number of continous capture iterations"
	default 5
	range 1 255
	help
	  Number of capture iterations run by each continuous capture test case.
```

## tests/drivers/i3c/i3c_emul/testcase.yaml
```yaml
tests:
  drivers.i3c.emul:
    platform_allow:
      - native_sim
    tags:
      - drivers
      - i3c
      - emul
```

## tests/drivers/i3c/i3c_loopback/testcase.yaml
```yaml
# Copyright (c) 2026 Meta Platforms
# SPDX-License-Identifier: Apache-2.0

common:
  tags:
    - drivers
    - i3c
    - loopback
  harness: ztest
  harness_config:
    fixture: i3c_loopback

tests:
  drivers.i3c.loopback:
    # In-tree boards listed here are built-only smoke targets to catch
    # source/binding regressions. To actually run the suite the user
    # must wire two i3c controllers together and supply the
    # `i3c_loopback` fixture to twister.
    build_only: true
    platform_allow:
      - nucleo_h503rb
```

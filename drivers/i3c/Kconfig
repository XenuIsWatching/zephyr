## drivers/i3c/Kconfig
```kconfig
# I3C configuration options
#
# Copyright (c) 2022 Intel Corporation
#
# SPDX-License-Identifier: Apache-2.0

menuconfig I3C
	bool "I3C Drivers"
	help
	  Enable I3C Driver Configuration

if I3C

module = I3C
module-str = i3c
source "subsys/logging/Kconfig.template.log_config"

config I3C_USE_GROUP_ADDR
	bool "Use Group Addresses"
	default y
	help
	  Enable this to use group addresses if supported
	  by the controllers and target devices.

	  Says Y if unsure.

config I3C_USE_IBI
	bool "Use In-Band Interrupt (IBI)"
	default y
	help
	  Enable this to use In-Band Interrupt (IBI).

	  Says Y if unsure.

config I3C_IBI_MAX_PAYLOAD_SIZE
	int "Maximum IBI Payload Size"
	depends on I3C_USE_IBI
	default 16
	help
	  Maxmium IBI payload size.

comment "Initialization Priority"

config I3C_CONTROLLER_INIT_PRIORITY
	int "I3C Controller Init Priority"
	# Default is just after CONFIG_KERNEL_INIT_PRIORITY_DEVICE
	default 50
	help
	  This is for setting up I3C controller device driver instance
	  so device driver instances for I2C and I3C devices on
	  the same bus can register themselves with the I3C controller
	  instance.

	  Device driver may initialize the hardware at this point, or
	  choose to do so during bus initialization.

config I3C_DEV_REGISTER_INIT_PRIORITY
	int "I3C Device Registration Init Priority"
	default 60
	help
	 This init priotiry for device driver instances for I2C and I3C
	 devices on the I3C bus to register themselves to the I3C
	 controller instance.

	 This needs to be done after CONFIG_I3C_CONTROLLER_INIT_PRIORITY
	 as the controller device driver instances need to prepare
	 internal data structures to accommodate device registration.

config I3C_BUS_INIT_PRIORITY
	int "I3C Bus Init Priority"
	# Default is before CONFIG_SENSOR_INIT_PRIORITY
	# as common I3C devices are sensors at the moment.
	default 70
	help
	  This init priority is for I3C controller device driver
	  instances to initialize the I3C bus (e.g. dynamic address
	  assignment).

	  This needs to be after CONFIG_I3C_DEV_REGISTER_INIT_PRIORITY
	  so the controller device driver instance knows how many
	  devices are connected on the bus.

	  Note that this needs to be done before the device driver
	  instances of the connected I2C and I3C devices start
	  initializing those devices. This is because some devices
	  may not be addressable until addresses are assigned by
	  the controller.

comment "Device Drivers"

rsource "Kconfig.nxp"

endif # I3C
```

## drivers/i3c/Kconfig.emul
```kconfig
# Copyright (c) 2026 Ryan McClelland
# SPDX-License-Identifier: Apache-2.0

config I3C_EMUL
	bool "I3C emulator"
	default y
	depends on DT_HAS_ZEPHYR_I3C_EMUL_CONTROLLER_ENABLED
	depends on EMUL
	help
	  Fake I3C bus controller that dispatches to peripheral emulators
	  registered via EMUL_DT_DEFINE. Used for testing I3C drivers and
	  higher-level subsystems on native_sim without real hardware.
```

## drivers/i3c/Kconfig.nxp
```kconfig
# Copyright (c) 2022 Intel Corporation
#
# SPDX-License-Identifier: Apache-2.0

DT_COMPAT_NXP_MCUX_I3C := nxp,mcux-i3c

module = I3C_MCUX
module-str = i3c-mcux
source "subsys/logging/Kconfig.template.log_config"

config I3C_MCUX
	bool "MCUX I3C driver"
	depends on HAS_MCUX
	select PINCTRL
	default $(dt_compat_enabled,$(DT_COMPAT_NXP_MCUX_I3C))
	help
	  Enable mcux I3C driver.
```

## drivers/i3c/Kconfig.stm32
```kconfig
# Copyright (c) 2024 Meta Platforms, Inc. and its affiliates.
#
# SPDX-License-Identifier: Apache-2.0

module = I3C_STM32
module-str = i3c-stm32
source "subsys/logging/Kconfig.template.log_config"

config I3C_STM32
	bool "STM32 I3C driver"
	select I3C_IBI_WORKQUEUE if I3C_USE_IBI
	depends on DT_HAS_ST_STM32_I3C_ENABLED
	select USE_STM32_LL_I3C
	select USE_STM32_LL_RCC
	select PINCTRL
	default y
	help
	  Enable STM32 I3C driver.
```

## drivers/sensor/bmi08x/Kconfig
```kconfig
# Bosch BMI08X inertial measurement configuration options

# Copyright (c) 2022 Meta Platforms, Inc. and its affiliates
# SPDX-License-Identifier: Apache-2.0

menuconfig BMI08X
	bool "Bosch BMI08X inertial measurement unit"
	depends on SPI || I2C
	help
	  Enable Bosch BMI08X inertial measurement unit that provides acceleration
	  and angular rate measurements.

if BMI08X

choice BMI08X_ACCEL_TRIGGER_MODE
	prompt "Accelerometer trigger mode"
	default BMI08X_ACCEL_TRIGGER_GLOBAL_THREAD
	help
	  Specify the type of triggering to be used by the driver.

config BMI08X_ACCEL_TRIGGER_NONE
	bool "No trigger"

config BMI08X_ACCEL_TRIGGER_GLOBAL_THREAD
	bool "Use global thread"
	select BMI08X_ACCEL_TRIGGER

config BMI08X_ACCEL_TRIGGER_OWN_THREAD
	bool "Use own thread"
	select BMI08X_ACCEL_TRIGGER
endchoice

config BMI08X_ACCEL_TRIGGER
	bool

config BMI08X_ACCEL_THREAD_PRIORITY
	int "Accelerometer own thread priority"
	depends on BMI08X_ACCEL_TRIGGER_OWN_THREAD
	default 10
	help
	  The priority of the thread used for handling interrupts.

config BMI08X_ACCEL_THREAD_STACK_SIZE
	int "Accelerometer own thread stack size"
	depends on BMI08X_ACCEL_TRIGGER_OWN_THREAD
	default 1536
	help
	  The thread stack size.

choice BMI08X_GYRO_TRIGGER_MODE
	prompt "Gyroscope trigger mode"
	default BMI08X_GYRO_TRIGGER_NONE if BMI08X_DATA_SYNC
	default BMI08X_GYRO_TRIGGER_GLOBAL_THREAD
	help
	  Specify the type of triggering to be used by the driver.

config BMI08X_GYRO_TRIGGER_NONE
	bool "No trigger"

config BMI08X_GYRO_TRIGGER_GLOBAL_THREAD
	bool "Use global thread" if !BMI08X_DATA_SYNC
	select BMI08X_GYRO_TRIGGER

config BMI08X_GYRO_TRIGGER_OWN_THREAD
	bool "Use own thread" if !BMI08X_DATA_SYNC
	select BMI08X_GYRO_TRIGGER
endchoice

config BMI08X_GYRO_TRIGGER
	bool

config BMI08X_GYRO_THREAD_PRIORITY
	int "Own thread priority"
	depends on BMI08X_GYRO_TRIGGER_OWN_THREAD
	default 10
	help
	  The priority of the thread used for handling interrupts.

config BMI08X_GYRO_THREAD_STACK_SIZE
	int "Own thread stack size"
	depends on BMI08X_GYRO_TRIGGER_OWN_THREAD
	default 1536
	help
	  The thread stack size.

config BMI08X_DATA_SYNC
	bool "Data synchronization between the accel and gyro"
	help
	  Enable data synchronization between the Accelerometer and Gyroscope for BMI08X

choice BMI08X_DATA_SYNC_ODR
	prompt "Data sync sampling frequency."
	depends on BMI08X_DATA_SYNC
	default BMI08X_DATA_SYNC_ODR_RUNTIME

config BMI08X_DATA_SYNC_ODR_RUNTIME
	bool "Set at runtime."

config BMI08X_DATA_SYNC_ODR_400
	bool "400 Hz"

config BMI08X_DATA_SYNC_ODR_1000
	bool "1000 Hz"

config BMI08X_DATA_SYNC_ODR_2000
	bool "2000 Hz"
endchoice

choice BMI08X_ACCEL_RANGE
	prompt "Accelerometer range setting"
	default BMI08X_ACCEL_RANGE_RUNTIME

config BMI08X_ACCEL_RANGE_RUNTIME
	bool "Set at runtime."

config BMI08X_ACCEL_RANGE_2G_3G
	bool "BMI085 2G / BMI088 3G"

config BMI08X_ACCEL_RANGE_4G_6G
	bool "BMI085 4G / BMI088 6G"

config BMI08X_ACCEL_RANGE_8G_12G
	bool "BMI085 8G / BMI088 12G"

config BMI08X_ACCEL_RANGE_16G_24G
	bool "BMI085 16G / BMI088 24G"
endchoice

choice BMI08X_ACCEL_ODR
	prompt "Accelerometer sampling frequency."
	default BMI08X_ACCEL_ODR_1600 if BMI08X_DATA_SYNC_ODR_2000
	default BMI08X_ACCEL_ODR_800 if BMI08X_DATA_SYNC_ODR_1000
	default BMI08X_ACCEL_ODR_400 if BMI08X_DATA_SYNC_ODR_400
	default BMI08X_ACCEL_ODR_RUNTIME

config BMI08X_ACCEL_ODR_RUNTIME
	bool "Set at runtime." if !BMI08X_DATA_SYNC

config BMI08X_ACCEL_ODR_25_2
	bool "12.5 Hz" if !BMI08X_DATA_SYNC

config BMI08X_ACCEL_ODR_25
	bool "25 Hz" if !BMI08X_DATA_SYNC

config BMI08X_ACCEL_ODR_50
	bool "50 Hz" if !BMI08X_DATA_SYNC

config BMI08X_ACCEL_ODR_100
	bool "100 Hz" if !BMI08X_DATA_SYNC

config BMI08X_ACCEL_ODR_200
	bool "200 Hz" if !BMI08X_DATA_SYNC

config BMI08X_ACCEL_ODR_400
	bool "400 Hz" if ((BMI08X_DATA_SYNC && BMI08X_DATA_SYNC_ODR_400) || !BMI08X_DATA_SYNC)

config BMI08X_ACCEL_ODR_800
	bool "800 Hz" if ((BMI08X_DATA_SYNC && BMI08X_DATA_SYNC_ODR_1000) || !BMI08X_DATA_SYNC)

config BMI08X_ACCEL_ODR_1600
	bool "1600 Hz" if ((BMI08X_DATA_SYNC && BMI08X_DATA_SYNC_ODR_2000) || !BMI08X_DATA_SYNC)
endchoice

choice BMI08X_GYRO_RANGE
	prompt "Gyroscope range setting."
	default BMI08X_GYRO_RANGE_RUNTIME

config BMI08X_GYRO_RANGE_RUNTIME
	bool "Set at runtime."

config BMI08X_GYRO_RANGE_2000DPS
	bool "2000 DPS"

config BMI08X_GYRO_RANGE_1000DPS
	bool "1000 DPS"

config BMI08X_GYRO_RANGE_500DPS
	bool "500 DPS"

config BMI08X_GYRO_RANGE_250DPS
	bool "250 DPS"

config BMI08X_GYRO_RANGE_125DPS
	bool "125 DPS"
endchoice

choice BMI08X_GYRO_ODR
	prompt "Gyroscope sampling frequency."
	default BMI08X_GYRO_ODR_2000_532 if BMI08X_DATA_SYNC_ODR_2000
	default BMI08X_GYRO_ODR_1000_116 if BMI08X_DATA_SYNC_ODR_1000
	default BMI08X_GYRO_ODR_400_47 if BMI08X_DATA_SYNC_ODR_400
	default BMI08X_GYRO_ODR_RUNTIME

config BMI08X_GYRO_ODR_RUNTIME
	bool "Set at runtime." if !BMI08X_DATA_SYNC

config BMI08X_GYRO_ODR_100_12
	bool "100 Hz, 12Hz filter" if !BMI08X_DATA_SYNC

config BMI08X_GYRO_ODR_100_32
	bool "100 Hz, 32Hz filter" if !BMI08X_DATA_SYNC

config BMI08X_GYRO_ODR_200_23
	bool "200 Hz, 23Hz filter" if !BMI08X_DATA_SYNC

config BMI08X_GYRO_ODR_200_64
	bool "200 Hz, 64Hz filter" if !BMI08X_DATA_SYNC

config BMI08X_GYRO_ODR_400_47
	bool "400 Hz, 47Hz filter" if ((BMI08X_DATA_SYNC && BMI08X_DATA_SYNC_ODR_400) || !BMI08X_DATA_SYNC)

config BMI08X_GYRO_ODR_1000_116
	bool "1000 Hz, 116Hz filter" if ((BMI08X_DATA_SYNC && BMI08X_DATA_SYNC_ODR_1000) || !BMI08X_DATA_SYNC)

config BMI08X_GYRO_ODR_2000_230
	bool "2000 Hz, 230Hz filter" if ((BMI08X_DATA_SYNC && BMI08X_DATA_SYNC_ODR_2000) || !BMI08X_DATA_SYNC)

config BMI08X_GYRO_ODR_2000_532
	bool "2000 Hz, 532Hz filter" if ((BMI08X_DATA_SYNC && BMI08X_DATA_SYNC_ODR_2000) || !BMI08X_DATA_SYNC)
endchoice

config BMI08X_I2C_WRITE_BURST_SIZE
	int "Maximum length of single i2c write"
	default 16

endif # BMI08X
```

## dts/bindings/i3c/zephyr,i3c-emul-controller.yaml
```yaml
# Copyright (c) 2026 Ryan McClelland
# SPDX-License-Identifier: Apache-2.0

description: Zephyr I3C Emulation controller

compatible: "zephyr,i3c-emul-controller"

include: i3c-controller.yaml

properties:
  reg:
    required: true
```

## dts/bindings/sensor/bosch,bmi08x-accel.yaml
```yaml
# Copyright (c) 2022 Meta Platforms, Inc. and its affiliates.
# SPDX-License-Identifier: Apache-2.0

description: BMI08X Accel inertial measurement unit

include: sensor-device.yaml

properties:
    int-gpios:
      type: phandle-array
      required: false
      description: |
        This property specifies the connection for INT, because the
        Zephyr driver maps all interrupts to INT.  The signal defaults
        to output low when produced by the sensor.

    int1-map-io:
      type: int
      required: false
      description: |
        Bit[0]: Map Interrupt A to INT1, Accel Data Ready
        Bit[1]: Map Interrupt B to INT1
        Bit[2]: Map Interrupt C to INT1

    int2-map-io:
      type: int
      required: false
      description: |
        Bit[0]: Map Interrupt A to INT2, Accel Data Ready
        Bit[1]: Map Interrupt B to INT2
        Bit[2]: Map Interrupt C to INT2

    int1-io-conf:
      type: int
      required: false
      description: |
        Bit[0]: reserved
        Bit[1]: if set to 1, INT1 is active high, otherwise it's active low
        Bit[2]: if set to 1, INT1 is open-drain, otherwise it's push-pull
        Bit[3]: if set to 1, enable INT1 as an output pin
        Bit[4]: if set to 1, enable INT1 as an input pin
        Bit[7:5] : reserved

    int2-io-conf:
      type: int
      required: false
      description: |
        Bit[0]: reserved
        Bit[1]: if set to 1, INT2 is active high, otherwise it's active low
        Bit[2]: if set to 1, INT2 is open-drain, otherwise it's push-pull
        Bit[3]: if set to 1, enable INT2 as an output pin
        Bit[4]: if set to 1, enable INT2 as an input pin
        Bit[7:5] : reserved
```

## dts/bindings/sensor/st,lsm6dso-i3c.yaml
```yaml
# Copyright (c) 2019 STMicroelectronics
# SPDX-License-Identifier: Apache-2.0

description: |
    STMicroelectronics LSM6DSO 6-axis IMU (Inertial Measurement Unit) sensor
    accessed through I3C bus

compatible: "st,lsm6dso"

include: ["i3c-device.yaml", "st,lsm6dso-common.yaml"]
```

## modules/Kconfig.cmsis_dsp
```kconfig
# Copyright (c) 2020 Stephanos Ioannidis <root@stephanos.io>
# SPDX-License-Identifier: Apache-2.0

comment "Instruction Set"
# NOTE: These configurations should eventually be derived from the arch ISA and
#       FP support configurations.

config CMSIS_DSP_NEON
	bool "Neon Instruction Set"
	default y
	depends on CPU_CORTEX_A
	help
	  This option enables the NEON Advanced SIMD instruction set, which is
	  available on most Cortex-A and some Cortex-R processors.

config CMSIS_DSP_NEON_EXPERIMENTAL
	bool "Neon Instruction Set"
	depends on CPU_CORTEX_A
	help
	  This option enables the NEON Advanced SIMD instruction set, which is
	  available on most Cortex-A and some Cortex-R processors.

config CMSIS_DSP_HELIUM
	bool "Helium Instruction Set"
	default y
	depends on ARMV8_1_M_MVEI || ARMV8_1_M_MVEF
	help
	  This option enables the Helium Advanced SIMD instruction set, which is
	  available on some Cortex-M processors.

config CMSIS_DSP_HELIUM_EXPERIMENTAL
	bool "Helium Instruction Set"
	depends on ARMV8_1_M_MVEI || ARMV8_1_M_MVEF
	help
	  This option enables the Helium Advanced SIMD instruction set, which is
	  available on some Cortex-M processors.

config CMSIS_DSP_MVEF
	bool "MVEF Instruction Set"
	default y
	depends on ARMV8_1_M_MVEF
	help
	  This option enables the Helium Advanced SIMD instruction set, which is
	  available on some Cortex-M processors.

config CMSIS_DSP_MVEI
	bool "MVEI Instruction Set"
	default y
	depends on ARMV8_1_M_MVEI
	help
	  This option enables the Helium Advanced SIMD instruction set, which is
	  available on some Cortex-M processors.

config CMSIS_DSP_MVE_FLOAT16
	bool "MVEF Float16 Instruction Set"
	default y
	depends on ARMV8_1_M_MVEF && FP16
	help
	  This option enables the Helium Advanced SIMD instruction set, which is
	  available on some Cortex-M processors.

comment "Features"

config CMSIS_DSP_LOOPUNROLL
	bool "Loop Unrolling"
	help
	  This option enables manual loop unrolling in the DSP functions.

config CMSIS_DSP_ROUNDING
	bool "Rounding"
	help
	  This option enables rounding on the support functions.

config CMSIS_DSP_MATRIXCHECK
	bool "Matrix Check"
	help
	  This option enables validation of the input and output sizes of
	  matrices.

config CMSIS_DSP_AUTOVECTORIZE
	bool "Auto Vectorize"
	help
	  This option prefers autovectorizable code to one using C intrinsics
	  in the DSP functions.

config CMSIS_DSP_FLOAT16
	bool "Half-Precision (16-bit Float) Support"
	default y
	depends on FP16
	help
	  This option enables the half-precision (16-bit) floating-point
	  operations support.

config CONFIG_CMSIS_DSP_LAX_VECTOR_CONVERSIONS
	bool "Lax Vector Conversions"
	depends on CMSIS_DSP_HELIUM || CMSIS_DSP_MVEF || CMSIS_DSP_MVEI
	help
	  This option enables the half-precision (16-bit) floating-point
	  operations support.
```

## samples/sensor/lsm6dso_i3c/sample.yaml
```yaml
sample:
  name: LSM6DSO accelerometer and gyrometer sensor (using I3C)
tests:
  sample.sensor.lsm6dso.i3c:
    harness: console
    tags: sensors
    depends_on: i3c
    timeout: 15
    build_only: true
    harness_config:
      type: multi_line
      ordered: true
      regex:
        - "accel x:[-.0-9]* ms/2 y:[-.0-9]* ms/2 z:[-.0-9]* ms/2"
        - "gyro x:[-.0-9]* dps y:[-.0-9]* dps z:[-.0-9]* dps"
        - "trig_cnt:[0-9]*"
```

## tests/drivers/build_all/spi/testcase.yaml
```yaml
common:
  build_only: true
  tags:
    - drivers
    - spi
tests:
  drivers.i3c.build:
    # will cover drivers without in-tree boards
    platform_allow: qemu_cortex_m3
    tags: spi_cdns
    extra_args: "CONFIG_SPI=y"
```
